#include "ssd1306.h"
#include <string.h>

/* 7-bit addr 0x3C -> HAL 8-bit 0x78 */
#define SSD1306_I2C_ADDR (0x3CU << 1)

static I2C_HandleTypeDef *s_hi2c;
static uint8_t s_buf[SSD1306_WIDTH * SSD1306_HEIGHT / 8];
static uint8_t s_x;
static uint8_t s_page;

/* 5x7 font, ASCII 32..90 */
static const uint8_t Font5x7[][5] = {
  {0x00,0x00,0x00,0x00,0x00}, /* space */
  {0x00,0x00,0x5F,0x00,0x00}, /* ! */
  {0x00,0x07,0x00,0x07,0x00}, /* " */
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  {0x61,0x51,0x49,0x45,0x43}, /* Z */
};

/* Original 8x12 digits, one byte per row with the left pixel in bit 7. */
static const uint8_t Number8x12[10][12] = {
  {0x3C,0x7E,0xC3,0xC3,0xC3,0xC3,0xC3,0xC3,0xC3,0xC3,0x7E,0x3C},
  {0x18,0x38,0x78,0x18,0x18,0x18,0x18,0x18,0x18,0x18,0x7E,0x7E},
  {0x3C,0x7E,0xC3,0x03,0x06,0x0C,0x18,0x30,0x60,0xC0,0xFF,0xFF},
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  {0x3C,0x7E,0xC3,0xC3,0xC3,0x7F,0x3F,0x03,0x03,0x06,0x7C,0x78}
};

void SSD1306_Fill(uint8_t lit)
{
  memset(s_buf, lit ? 0xFF : 0x00, sizeof(s_buf));
  s_x = 0;
  s_page = 0;
}

void SSD1306_DrawPixel(int16_t x, int16_t y, uint8_t lit)
{
  if (x < 0 || x >= SSD1306_WIDTH || y < 0 || y >= SSD1306_HEIGHT) return;
  const uint16_t index = (uint16_t)((y / 8) * SSD1306_WIDTH + x);
  const uint8_t mask = (uint8_t)(1U << (y & 7));
  if (lit) s_buf[index] |= mask;
  else s_buf[index] &= (uint8_t)~mask;
}

void SSD1306_FillRect(int16_t x, int16_t y, int16_t width, int16_t height, uint8_t lit)
{
  if (width <= 0 || height <= 0) return;
  int32_t right = (int32_t)x + width;
  int32_t bottom = (int32_t)y + height;
  if (x < 0) x = 0;
  if (y < 0) y = 0;
  if (right > SSD1306_WIDTH) right = SSD1306_WIDTH;
  if (bottom > SSD1306_HEIGHT) bottom = SSD1306_HEIGHT;
  for (int16_t py = y; py < bottom; ++py)
    for (int16_t px = x; px < right; ++px)
      SSD1306_DrawPixel(px, py, lit);
}

uint16_t SSD1306_TextWidth(const char *s, uint8_t scale)
{
  if (s == NULL || scale == 0 || scale > 3) return 0;
  uint16_t count = 0;
  while (*s++ && count < SSD1306_WIDTH) ++count;
  return count ? (uint16_t)((count * 6U - 1U) * scale) : 0;
}

void SSD1306_DrawText(int16_t x, int16_t y, const char *s, uint8_t scale, uint8_t lit)
{
  if (s == NULL || scale == 0 || scale > 3) return;
  while (*s && x < SSD1306_WIDTH)
  {
    char c = *s++;
    if (c >= 'a' && c <= 'z') c = (char)(c - 'a' + 'A');
    if (c < 32 || c > 90) c = '?';
    const uint8_t *glyph = Font5x7[c - 32];
    for (uint8_t col = 0; col < 5; ++col)
      for (uint8_t row = 0; row < 7; ++row)
        if (glyph[col] & (1U << row))
          SSD1306_FillRect((int16_t)(x + col * scale), (int16_t)(y + row * scale),
                           scale, scale, lit);
    x = (int16_t)(x + 6U * scale);
  }
}

uint16_t SSD1306_NumberWidth(const char *s)
{
  if (s == NULL) return 0;
  uint16_t width = 0;
  while (*s && width < 1024U)
  {
    width += *s++ == '.' ? 4U : 10U;
  }
  return width ? (uint16_t)(width - 2U) : 0;
}

void SSD1306_DrawNumber(int16_t x, int16_t y, const char *s, uint8_t lit)
{
  if (s == NULL) return;
  while (*s && x < SSD1306_WIDTH)
  {
    const char c = *s++;
    if (c >= '0' && c <= '9')
    {
      const uint8_t *glyph = Number8x12[c - '0'];
      for (uint8_t row = 0; row < 12; ++row)
        for (uint8_t col = 0; col < 8; ++col)
          if (glyph[row] & (0x80U >> col))
            SSD1306_DrawPixel((int16_t)(x + col), (int16_t)(y + row), lit);
    }
    else if (c == '-') SSD1306_FillRect(x, (int16_t)(y + 5), 8, 2, lit);
    else if (c == '.') SSD1306_FillRect(x, (int16_t)(y + 10), 2, 2, lit);
    x = (int16_t)(x + (c == '.' ? 4 : 10));
  }
}

static HAL_StatusTypeDef WriteCmd(uint8_t cmd)
{
  uint8_t data[2] = {0x00, cmd};
  return HAL_I2C_Master_Transmit(s_hi2c, SSD1306_I2C_ADDR, data, 2, 100);
}

static void DrawChar(char c)
{
  if (c < 32 || c > 90)
  {
    c = '?';
  }
  if (s_x > SSD1306_WIDTH - 6 || s_page > 7)
  {
    return;
  }

  const uint8_t *g = Font5x7[c - 32];
  for (uint8_t i = 0; i < 5; i++)
  {
    s_buf[s_page * SSD1306_WIDTH + s_x + i] = g[i];
  }
  s_buf[s_page * SSD1306_WIDTH + s_x + 5] = 0x00;
  s_x = (uint8_t)(s_x + 6);
}

HAL_StatusTypeDef SSD1306_Init(I2C_HandleTypeDef *hi2c)
{
  s_hi2c = hi2c;
  HAL_Delay(50);

  if (HAL_I2C_IsDeviceReady(s_hi2c, SSD1306_I2C_ADDR, 3, 100) != HAL_OK)
  {
    return HAL_ERROR;
  }

  static const uint8_t init[] = {
    0xAE, 0xD5, 0x80, 0xA8, 0x3F, 0xD3, 0x00, 0x40,
    0x8D, 0x14, 0x20, 0x00, 0xA1, 0xC8, 0xDA, 0x12,
    0x81, 0xCF, 0xD9, 0xF1, 0xDB, 0x40, 0xA4, 0xA6, 0xAF
  };

  for (uint32_t i = 0; i < sizeof(init); i++)
  {
    if (WriteCmd(init[i]) != HAL_OK)
    {
      return HAL_ERROR;
    }
  }

  SSD1306_Clear();
  SSD1306_Update();
  return HAL_OK;
}

void SSD1306_Clear(void)
{
  SSD1306_Fill(SSD1306_BLACK);
}

void SSD1306_SetCursor(uint8_t x, uint8_t page)
{
  s_x = x;
  s_page = page;
}

void SSD1306_WriteString(const char *s)
{
  while (*s)
  {
    char c = *s++;
    if (c >= 'a' && c <= 'z')
    {
      c = (char)(c - 32);
    }
    DrawChar(c);
  }
}

void SSD1306_Update(void)
{
  for (uint8_t page = 0; page < 8; page++)
  {
    WriteCmd((uint8_t)(0xB0 + page));
    WriteCmd(0x00);
    WriteCmd(0x10);

    uint8_t packet[1 + SSD1306_WIDTH];
    packet[0] = 0x40;
    memcpy(&packet[1], &s_buf[page * SSD1306_WIDTH], SSD1306_WIDTH);
    HAL_I2C_Master_Transmit(s_hi2c, SSD1306_I2C_ADDR, packet, sizeof(packet), 100);
  }
}
